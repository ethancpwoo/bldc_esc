# file: esc.ioc
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Mcu.Family=STM32F1
Mcu.Name=STM32F103C(8-B)Tx
Mcu.Package=LQFP48
NVIC.PriorityGroup=NVIC_PRIORITYGROUP_4
ProjectManager.HeapSize=0x200
ProjectManager.StackSize=0x400
ProjectManager.TargetToolchain=STM32CubeIDE
RCC.APB1Freq_Value=8000000
RCC.APB2Freq_Value=8000000
board=custom

// file: Core/Src/main.c
/* USER CODE BEGIN Header */
/**
  ******************************************************************************
  * @file           : main.c
  * @brief          : Main program body
  ******************************************************************************
  * @attention
  *
  * Copyright (c) 2025 STMicroelectronics.
  * All rights reserved.
  *
  * This software is licensed under terms that can be found in the LICENSE file
  * in the root directory of this software component.
  * If no LICENSE file comes with this software, it is provided AS-IS.
  *
  ******************************************************************************
  */
/* USER CODE END Header */
#include "main.h"

void SystemClock_Config(void);

int main(void)
{

  /* MCU Configuration--------------------------------------------------------*/

  /* Reset of all peripherals, Initializes the Flash interface and the Systick. */
  HAL_Init();

  /* Configure the system clock */
  SystemClock_Config();

  /* Initialize all configured peripherals */
  /* USER CODE BEGIN 2 */

  RCC->APB1ENR |= RCC_APB1ENR_TIM2EN;
  RCC->APB2ENR |= RCC_APB2ENR_TIM1EN;
  RCC->AHB1ENR |= RCC_AHB1ENR_GPIOAEN;

  TIM1->CR1 = 0;
  TIM1->PSC = 7;
  TIM1->ARR = 45;
  TIM1->DIER |= TIM_DIER_UIE;
  TIM1->CR1 |= TIM_CR1_CEN;

  TIM2->CR1 = 0;
  TIM2->PSC = 1599;
  TIM2->ARR = 6249;
  TIM2->DIER |= TIM_DIER_UIE;
  TIM2->CR1 |= TIM_CR1_CEN;

  GPIOA->MODER |= (0x5555 << 0);
  GPIOA->OTYPER &= ~(0xFF << 0);
  GPIOA->OSPEEDR |= (0xFFFF << 0);

  NVIC_EnableIRQ(TIM1_UP_TIM10_IRQn);
  NVIC_EnableIRQ(TIM2_IRQn);

  void TIM1_UP_TIM10_IRQHandler(void) {
      if (TIM1->SR & TIM_SR_UIF) {
          TIM1->SR &= ~TIM_SR_UIF;
          if (current_on) current_on = false;
      }
  }

  void TIM1_CC_IRQHandler(void) {
      if (TIM1->SR & TIM_SR_CC1IF) {
          TIM1->SR &= ~TIM_SR_CC1IF;
          if (!current_on) current_on = true;
      }
  }

  void TIM2_IRQHandler(void) {
      if (TIM2->SR & TIM_SR_UIF) {
          TIM2->SR &= ~TIM_SR_UIF;
          step++;
          if (step == 6) step = 0;
      }
  }

  /* USER CODE END 2 */

  /* Infinite loop */
  while (1)
  {
	  switch (step) {
		  case 0:
			  GPIOA->ODR = current_on ? 0x0C : 0x80;
			  break;
		  case 1:
			  GPIOA->ODR = current_on ? 0xC8 : 0x08;
			  break;
		  case 2:
			  GPIOA->ODR = current_on ? 0xE0 : 0x20;
			  break;
		  case 3:
			  GPIOA->ODR = current_on ? 0xB0 : 0x80;
			  break;
		  case 4:
			  GPIOA->ODR = current_on ? 0x38 : 0x08;
			  break;
		  case 5:
			  GPIOA->ODR = current_on ? 0x2C : 0x20;
			  break;
	  }
  }
}

void SystemClock_Config(void)
{
  RCC_OscInitTypeDef RCC_OscInitStruct = {0};
  RCC_ClkInitTypeDef RCC_ClkInitStruct = {0};

  /** Initializes the RCC Oscillators according to the specified parameters
  * in the RCC_OscInitTypeDef structure.
  */
  RCC_OscInitStruct.OscillatorType = RCC_OSCILLATORTYPE_HSI;
  RCC_OscInitStruct.HSIState = RCC_HSI_ON;
  RCC_OscInitStruct.HSICalibrationValue = RCC_HSICALIBRATION_DEFAULT;
  RCC_OscInitStruct.PLL.PLLState = RCC_PLL_NONE;
  if (HAL_RCC_OscConfig(&RCC_OscInitStruct) != HAL_OK)
  {
    Error_Handler();
  }

  /** Initializes the CPU, AHB and APB buses clocks
  */
  RCC_ClkInitStruct.ClockType = RCC_CLOCKTYPE_HCLK|RCC_CLOCKTYPE_SYSCLK
                              |RCC_CLOCKTYPE_PCLK1|RCC_CLOCKTYPE_PCLK2;
  RCC_ClkInitStruct.SYSCLKSource = RCC_SYSCLKSOURCE_HSI;
  RCC_ClkInitStruct.AHBCLKDivider = RCC_SYSCLK_DIV1;
  RCC_ClkInitStruct.APB1CLKDivider = RCC_HCLK_DIV1;
  RCC_ClkInitStruct.APB2CLKDivider = RCC_HCLK_DIV1;

  if (HAL_RCC_ClockConfig(&RCC_ClkInitStruct, FLASH_LATENCY_0) != HAL_OK)
  {
    Error_Handler();
  }
}

void Error_Handler(void)
{
  __disable_irq();
  while (1)
  {
  }
}
